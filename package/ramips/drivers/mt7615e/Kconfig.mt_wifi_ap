## package/ramips/drivers/mt7615e/Kconfig.mt_wifi_ap
```kconfig
config MT7615E_MT_AP_SUPPORT
	tristate "MTK AP support"
#	depends on MT7615E_NET_RADIO
	select MT7615E_WIRELESS_EXT
	select MT7615E_WEXT_SPY
	select MT7615E_WEXT_PRIV

config MT7615E_WDS_SUPPORT
	bool "WDS"
	depends on MT7615E_MT_AP_SUPPORT
	default y

config MT7615E_MBSS_SUPPORT
	bool "MBSSID"
	depends on MT7615E_MT_AP_SUPPORT
	default y

#config MT7615E_NEW_MBSSID_MODE
#	bool "New MBSSID MODE"
#	depends on MT7615E_MT_AP_SUPPORT && MBSS_SUPPORT
#	depends on MT7615E_RALINK_RT3883 || RALINK_RT3352 || RALINK_RT5350 || RALINK_RT6352 || RALINK_MT7620
#	default y

#config MT7615E_ENHANCE_NEW_MBSSID_MODE
#	bool "Enhanced MBSSID mode"
#	depends on MT7615E_NEW_MBSSID_MODE
#	default y

config MT7615E_APCLI_SUPPORT
	bool "AP-Client Support"
	depends on MT7615E_MT_AP_SUPPORT
	default y

config MT7615E_APCLI_CERT_SUPPORT
        bool "AP-Client TGn Cert Support"
	depends on MT7615E_MT_AP_SUPPORT
        depends on MT7615E_APCLI_SUPPORT
        default n

config MT7615E_MAC_REPEATER_SUPPORT
	bool "MAC Repeater Support"
	depends on MT7615E_MT_AP_SUPPORT
	depends on MT7615E_APCLI_SUPPORT
	depends on MT7615E_RALINK_RT6352 || RALINK_MT7620 || RALINK_MT7603E || MT_AP_SUPPORT
	default y

config MT7615E_MWDS
    bool "Mixed WDS(MWDS)"
    depends on MT7615E_MT_AP_SUPPORT
    select MT7615E_APCLI_SUPPORT
    default n

config MT7615E_MUMIMO_SUPPORT
        bool "MU-MIMO Support"
        depends on MT7615E_WIFI_DRIVER
        select MT7615E_MU_RA_SUPPORT
        default y

config MT7615E_MU_RA_SUPPORT
  	bool "MU-RGA Support"
  	depends on MT7615E_MUMIMO_SUPPORT

config MT7615E_DOT11R_FT_SUPPORT
	bool "802.11r Fast BSS Transition"
	depends on MT7615E_MT_AP_SUPPORT
	default n

config MT7615E_DOT11K_RRM_SUPPORT
	bool "802.11k Radio Resource Management"
	depends on MT7615E_MT_AP_SUPPORT
	default n

config MT7615E_MAP_SUPPORT
	bool "Multi-AP Support"
	depends on MT7615E_MT_AP_SUPPORT
	select MT7615E_MBO_SUPPORT
	default n

#config MT7615E_SNIFFER_SUPPORT
#	bool "SNIFFER"
#	depends on MT7615E_MT_AP_SUPPORT
#	default n

config MT7615E_CFG80211_SUPPORT
	bool "CFG80211"
	depends on MT7615E_MT_AP_SUPPORT
	default y

#config MT7615E_DSCP_PRI_SUPPORT
#	"Dscp Priority Mapping Support"
#	depends on MT7615E_MT_AP_SUPPORT
#	default n

config MT7615E_DSCP_PRI_SUPPORT
	bool "Dscp Priority Mapping Support"
	depends on MT7615E_MT_AP_SUPPORT
	default n

config MT7615E_CON_WPS_SUPPORT
	bool "Concurrent WPS Support"
	depends on MT7615E_MT_AP_SUPPORT
	depends on MT7615E_APCLI_SUPPORT
	depends on MT7615E_WSC_INCLUDED
	depends on MT7615E_WSC_V2_SUPPORT
#	depends on MT7615E_MULTI_INF_SUPPORT
	default n

#config MT7615E_LLTD_SUPPORT
#	bool "LLTD (Link Layer Topology Discovery Protocol)"
#	depends on MT7615E_MT_AP_SUPPORT

#config MT7615E_COC_SUPPORT
#	bool "CoC Support"
#	depends on MT7615E_MT_AP_SUPPORT
#	default n

config MT7615E_MCAST_RATE_SPECIFIC
	bool "User specific tx rate of mcast pkt"
	depends on MT7615E_MT_AP_SUPPORT
	default y

#config MT7615E_EXT_BUILD_CHANNEL_LIST
#	bool "Extension Channel List"
#	depends on MT7615E_MT_AP_SUPPORT

#config MT7615E_AUTO_CH_SELECT_ENHANCE
#	bool "Auto Channel Selection Enhancement"
#	depends on MT7615E_MT_AP_SUPPORT

config MT7615E_VOW_SUPPORT
	bool "MediaAir(VOW) support"
	depends on MT7615E_MT_AP_SUPPORT
	default y

#config MT7615E_AIRPLAY_SUPPORT
#	bool "AIRPLAY Support"
#	depends on MT7615E_MT_AP_SUPPORT
#	default n

config MT7615E_BAND_STEERING
	bool "Band Steering"
	depends on MT7615E_MT_AP_SUPPORT
	default y

config MT7615E_LED_CONTROL_SUPPORT
        bool "LED Control Support"
        default n

config MT7615E_WLAN_HOOK
       bool "WLAN hook Support"
       depends on MT7615E_WIFI_DRIVER
       default n

config MT7615E_RADIUS_ACCOUNTING_SUPPORT
	bool "Radius Accounting Support"
	depends on MT7615E_MT_AP_SUPPORT
	default n

config MT7615E_GREENAP_SUPPORT
	bool "GreenAP Support"
	depends on MT7615E_MT_AP_SUPPORT
	default y

config MT7615E_PCIE_ASPM_DYM_CTRL_SUPPORT
	bool "Pcie Aspm Dynamic Control Support"
	depends on MT7615E_MT_AP_SUPPORT
	default y

config MT7615E_COEX_SUPPORT
	bool "Coex Support"
	depends on MT7615E_MT_AP_SUPPORT
	default n

config MT7615E_EASY_SETUP_SUPPORT
	bool "Whole Home Coverage - Easy Setup"
	depends on MT7615E_MT_AP_SUPPORT
	default n

config MT7615E_EVENT_NOTIFIER_SUPPORT
	bool "Whole Home Coverage - Event Notifier"
	depends on MT7615E_MT_AP_SUPPORT
	default n

config MT7615E_AIR_MONITOR
        bool "Air Monitor"
        depends on MT7615E_MT_AP_SUPPORT
        default n

config MT7615E_WNM_SUPPORT
        bool "802.11v WNM Support"
        depends on MT7615E_MT_AP_SUPPORT
        default n

config MT7615E_WIFI_MSI_SUPPORT
        bool "MSI support"
        depends on MT7615E_PCI_MSI
        depends on MT7615E_CHIP_MT7615E
        default n


#config MT7615E_ROAMING_ENHANCE_SUPPORT
#	bool "Roaming Enhance Support"
#	depends on MT7615E_MT_AP_SUPPORT
#	depends on MT7615E_APCLI_SUPPORT
#	default n

#config MT7615E_WIFI_FWD_SUPPORT
#        bool "WiFi Forwarding Support"
#        default n
```
