## package/ramips/drivers/mt7615e/config.in
```kconfig
if PACKAGE_kmod-mt7615e

config MT7615E_AP_SUPPORT
	bool
	default y
	depends on PACKAGE_kmod-mt7615e

config MT7615E_SUPPORT_OPENWRT
	bool
	default y
	depends on PACKAGE_kmod-mt7615e

config MT7615E_RT_FIRST_CARD
	string
	default 7615e
	depends on PACKAGE_kmod-mt7615e

config MT7615E_RT_SECOND_CARD
	string
	default 7615e
	depends on PACKAGE_kmod-mt7615e

config MT7615E_RT_FIRST_IF_RF_OFFSET
	hex
	default 0x0

config MT7615E_RT_SECOND_IF_RF_OFFSET
	hex
	default 0x8000

#if FIRST_IF_MT7603E || SECOND_IF_MT7603E
config MT7615E_FIRST_IF_MT7615E
	bool
	default y
	depends on PACKAGE_kmod-mt7615e

config MT7615E_WIFI_DRIVER
	bool
	default y
	depends on PACKAGE_kmod-mt7615e
	select MT7615E_WIFI_MT_MAC
	select MT7615E_MT_MAC
	select MT7615E_CHIP_MT7615E
	select MT7615E_FIRST_IF_MT7615E
	select MT7615E_SECOND_IF_MT7615E

config MT7615E_MT_WIFI
	tristate "MT WIFI Driver"
	default y
	select MT7615E_WIFI_BASIC_FUNC if MT7615E_MT_WIFI

config MT7615E_MT_WIFI_PATH
	string
	depends on MT7615E_MT_WIFI
	default "mt_wifi"

if MT7615E_MT_WIFI
menu "WiFi Generic Feature Options"
choice
	prompt "EEPROM Type of 1st Card"
	depends on ! MT7615E_FIRST_IF_NONE

	config MT7615E_FIRST_IF_EEPROM_FLASH
	bool "FLASH"

	config MT7615E_RIRST_IF_EEPROM_EFUSE
	bool "EFUSE"
endchoice

config MT7615E_RT_FIRST_CARD_EEPROM
	string
	depends on ! MT7615E_FIRST_IF_NONE
	default "flash" if MT7615E_FIRST_IF_EEPROM_FLASH

choice
	prompt "EEPROM Type of 2nd Card"
	depends on ! MT7615E_SECOND_IF_NONE

	config MT7615E_SECOND_IF_EEPROM_FLASH
	bool "FLASH"

	config MT7615E_SECOND_IF_EEPROM_PROM
	bool "EEPROM"

	config MT7615E_SECOND_IF_EEPROM_EFUSE
	bool "EFUSE"
endchoice

config MT7615E_RT_SECOND_CARD_EEPROM
	string
	depends on ! MT7615E_SECOND_IF_NONE
	default "prom" if MT7615E_SECOND_IF_EEPROM_PROM
	default "efuse" if MT7615E_SECOND_IF_EEPROM_EFUSE
	default "flash" if MT7615E_SECOND_IF_EEPROM_FLASH

config MT7615E_MULTI_INF_SUPPORT
	bool
	default y if !MT7615E_FIRST_IF_NONE && !MT7615E_SECOND_IF_NONE

config WIRELESS_EXT
	bool
	default y

config WEXT_SPY
	bool
	default y

config WEXT_PRIV
	bool
	default y

config MT7615E_WIFI_BASIC_FUNC
	bool "Basic Functions"
	select WIRELESS_EXT
	select WEXT_SPY
	select WEXT_PRIV

config MT7615E_DOT11_N_SUPPORT
	bool "802.11n support"
	default y

config MT7615E_DOT11_VHT_AC
	bool "802.11AC support"
	depends on MT7615E_WIFI_DRIVER
	depends on MT7615E_DOT11_N_SUPPORT
	default y

config MT7615E_G_BAND_256QAM_SUPPORT
	bool "2.4G 256QAM support"
	depends on MT7615E_WIFI_DRIVER
	depends on MT7615E_DOT11_VHT_AC
	default y

config MT7615E_BRCM_256QAM_SUPPORT
	bool "BRCM 2.4G 256QAM support"
	depends on MT7615E_WIFI_DRIVER
	depends on MT7615E_G_BAND_256QAM_SUPPORT
	default y

config TPC_SUPPORT
	bool "802.11h TPC Support"
	depends on WIFI_DRIVER
	default y

config MT7615E_ICAP_SUPPORT
	bool "ICAP Support"
	depends on MT7615E_WIFI_DRIVER
	depends on MT7615E_MT_AP_SUPPORT
	default y

config MT7615E_BACKGROUND_SCAN_SUPPORT
	bool "Background Scan Support"
	depends on MT7615E_WIFI_DRIVER
	default y

config MT7615E_SMART_CARRIER_SENSE_SUPPORT
	bool "Smart Carrier Sense Support"
	depends on MT7615E_WIFI_DRIVER
	default y

config MT7615E_MT_DFS_SUPPORT
	bool "Dynamic Frequency Selection Support"
	depends on MT7615E_WIFI_DRIVER
	default y

#config WFA_VHT_R2_PF
#	bool "WFA VHT R2 Plugfest"
#	depends on DOT11_VHT_AC
#	default n

config MT7615E_HDR_TRANS_TX_SUPPORT
	bool "Tx Header Translation"
	depends on MT7615E_CHIP_MT7615E
	default y

config MT7615E_HDR_TRANS_RX_SUPPORT
	bool "Rx Header Translation"
	depends on MT7615E_CHIP_MT7615E
	default y

config MT7615E_DBDC_MODE
	bool "dbdc mode support"
	default n

config MULTI_PROFILE_SUPPORT
    bool "Multi Profile Support"
    depends on MT7615E_DBDC_MODE
    default n

config MT7615E_SUPPORT_DYNAMIC_TXOP
	bool "dynamic txop support"
	default y

config MT7615E_WSC_INCLUDED
	bool "WSC (WiFi Simple Config)"
	depends on MT7615E_WIFI_DRIVER
	depends on MT7615E_MT_AP_SUPPORT || MT7615E_MT_STA_SUPPORT
	default y

config MT7615E_WSC_V2_SUPPORT
	bool "WSC V2(WiFi Simple Config Version 2.0)"
	depends on MT7615E_WIFI_DRIVER
	depends on MT7615E_MT_AP_SUPPORT || MT7615E_MT_STA_SUPPORT
	default y

config MT7615E_DOT11W_PMF_SUPPORT
	bool "PMF"
	depends on MT7615E_WIFI_DRIVER
	depends on MT7615E_MT_AP_SUPPORT
	default y

config MT7615E_TXBF_SUPPORT
	bool "Tx Bean Forming Support"
	depends on MT7615E_WIFI_DRIVER
	default y

config MT7615E_VHT_TXBF_2G_EPIGRAM_IE_SUPPORT
    bool "BRCM 2.4G VHT Sounding support"
        depends on MT7615E_WIFI_DRIVER
        depends on MT7615E_TXBF_SUPPORT
        default n

#config LLTD_SUPPORT
#	bool "LLTD (Link Layer Topology Discovery Protocol)"
#	depends on WIFI_DRIVER
#	depends on MT_AP_SUPPORT
#	default n

#config QOS_DLS_SUPPORT
#	bool "802.11e DLS ((Direct-Link Setup) Support"
#	depends on WIFI_DRIVER
#	depends on MT_AP_SUPPORT
#	default n

#config WAPI_SUPPORT
#	bool "WAPI Support"
#	depends on WIFI_DRIVER
#	default n

#config FTM_SUPPORT
#	bool "FTM Support"
#	depends on WIFI_DRIVER
#	select PASSPOINT_R2
#	default n

#config CARRIER_DETECTION_SUPPORT
#	bool "Carrier Detect"
#	depends on WIFI_DRIVER
#	default n

config MT7615E_IGMP_SNOOP_SUPPORT
	bool "IGMP snooping"
	depends on MT7615E_WIFI_DRIVER
	depends on MT7615E_MT_AP_SUPPORT
	default y

#config BLOCK_NET_IF
#	bool "NETIF Block"
#	depends on WIFI_DRIVER
#	depends on MT_AP_SUPPORT
#	default n
#	help
#	Support Net interface block while Tx-Sw queue full

config MT7615E_RATE_ADAPTION
	bool "New Rate Adaptation support"
	depends on MT7615E_WIFI_DRIVER
	default y

#config NEW_RATE_ADAPT_SUPPORT
#	bool "Intelligent Rate Adaption"
#	depends on WIFI_DRIVER && RATE_ADAPTION
#	default y

#config AGS_SUPPORT
#	bool "Adaptive Group Switching"
#	depends on WIFI_DRIVER && RATE_ADAPTION
#	depends on MT_AP_SUPPORT || MT_STA_SUPPORT
#	default n

config MT7615E_RATE_ADAPT_AGBS_SUPPORT
	bool "Adaptive AGBS Mode"
	depends on MT7615E_WIFI_DRIVER && MT7615E_RATE_ADAPTION
	depends on MT7615E_MT_AP_SUPPORT || MT7615E_MT_STA_SUPPORT
	default y

#config IDS_SUPPORT
#	bool "IDS (Intrusion Detection System) Support"
#	depends on WIFI_DRIVER
#	depends on MT_AP_SUPPORT
#	default n

#config WIFI_WORK_QUEUE
#	bool "Work Queue"
#	depends on WIFI_DRIVER
#	default n

#config WIFI_SKB_RECYCLE
#	bool "SKB Recycle(Linux)"
#	depends on WIFI_DRIVER
#	depends on MT_AP_SUPPORT
#	default n

config MT7615E_RTMP_FLASH_SUPPORT
	bool "Flash Support"
	depends on MT7615E_WIFI_DRIVER
	default y

config MT7615E_CAL_TO_FLASH_SUPPORT
	bool "CalibrationToFlash Support"
	depends on MT7615E_WIFI_DRIVER
	depends on MT7615E_RTMP_FLASH_SUPPORT
	default n

#config LED_CONTROL_SUPPORT
#	bool "LED Support"
#	depends on WIFI_DRIVER
#	depends on MT_AP_SUPPORT
#	default n

config MT7615E_ATE_SUPPORT
	bool "ATE/QA Support"
	depends on MT7615E_WIFI_DRIVER
	depends on MT7615E_MT_AP_SUPPORT
	default y

#config MEMORY_OPTIMIZATION
#	bool "Memory Optimization"
#	depends on WIFI_DRIVER
#	default n

#config PASSPOINT_R2
#	bool "Passpoint Release-2 Support"
#	depends on WIFI_DRIVER
#	select DOT11W_PMF_SUPPORT
#	depends on MT_AP_SUPPORT
#	default n

#config TRACE_TCP_PKT
#	   bool "TCP DATA/ACK packets trace log"
#	   depends on WIFI_DRIVER
#	   default n

config MT7615E_UAPSD
	bool "UAPSD support"
	depends on MT7615E_WIFI_DRIVER
	depends on MT7615E_MT_AP_SUPPORT || MT7615E_MT_STA_SUPPORT
	default y

#config TCP_RACK_SUPPORT
#	bool "TCP Reduced ACK  support"
#	depends on WIFI_DRIVER
#	default n

#
# Section for chip architectures
#
# "RLT MAC Support"
config MT7615E_RLT_MAC
	bool
	depends on MT7615E_WIFI_DRIVER
	default n

config MT7615E_RLT_BBP
	bool

config MT7615E_RLT_RF
	bool

# "RTMP MAC Support"
config MT7615E_RTMP_MAC
	bool
	depends on MT7615E_WIFI_DRIVER
	default n

config MT7615E_RTMP_BBP
	bool

config MT7615E_RTMP_RF
	bool

#
# Section for interfaces
#
config MT7615E_RTMP_PCI_SUPPORT
	bool "pci support"
	default y

config MT7615E_RTMP_USB_SUPPORT
	bool

config MT7615E_RTMP_RBUS_SUPPORT
	bool

endmenu

menu "WiFi Operation Modes"
choice
	prompt "Main Mode"
	default MT7615E_WIFI_MODE_AP

	config MT7615E_WIFI_MODE_AP
		bool "AP"
		select MT7615E_MT_AP_SUPPORT

	config MT7615E_WIFI_MODE_STA
		bool "STA"
		select MT7615E_MT_STA_SUPPORT

	config MT7615E_WIFI_MODE_BOTH
		bool "APSTA"
		select MT7615E_MT_AP_SUPPORT
		select MT7615E_MT_STA_SUPPORT
endchoice

    if MT7615E_WIFI_MODE_AP || MT7615E_WIFI_MODE_BOTH
		source "Kconfig.mt_wifi_ap"
    endif
# if MT7615E_WIFI_MODE_AP || MT7615E_WIFI_MODE_BOTH
#	source "config.ap"
# endif

####################ap
#endmenu

config MT7615E_MT_AP_SUPPORT
	tristate "Ralink RT2860 802.11n AP support"
#	depends on NET_RADIO
	select WIRELESS_EXT
	select WEXT_SPY
	select WEXT_PRIV

config MT7615E_WDS_SUPPORT
	bool "WDS"
	depends on MT7615E_MT_AP_SUPPORT
	default n

config MT7615E_MBSS_SUPPORT
	bool "MBSSID"
	depends on MT7615E_MT_AP_SUPPORT
	default y

#config MT7615E_NEW_MBSSID_MODE
#	bool "New MBSSID MODE"
#	depends on MT_AP_SUPPORT && MBSS_SUPPORT
#	depends on RALINK_RT3883 || RALINK_RT3352 || RALINK_RT5350 || RALINK_RT6352 || RALINK_MT7620
#	default y

#config ENHANCE_NEW_MBSSID_MODE
#	bool "Enhanced MBSSID mode"
#	depends on NEW_MBSSID_MODE
#	default y

config MT7615E_APCLI_SUPPORT
	bool "AP-Client Support"
	depends on MT7615E_MT_AP_SUPPORT
	default y

config MT7615E_APCLI_CERT_SUPPORT
	bool "AP-Client TGn Cert Support"
	depends on MT7615E_MT_AP_SUPPORT
	depends on MT7615E_APCLI_SUPPORT
	default y

config MT7615E_MAC_REPEATER_SUPPORT
	bool "MAC Repeater Support"
	depends on MT7615E_MT_AP_SUPPORT
	depends on MT7615E_APCLI_SUPPORT
	depends on MT7615E_RALINK_RT6352 || MT7615E_RALINK_MT7620 || MT7615E_RALINK_MT7603E || MT7615E_MT_AP_SUPPORT
	default y

#config DOT11R_FT_SUPPORT
#	bool "802.11r Fast BSS Transition"
#	depends on MT_AP_SUPPORT

#config DOT11K_RRM_SUPPORT
#	bool "802.11k Radio Resource Management"
#	depends on MT_AP_SUPPORT

#config SNIFFER_SUPPORT
#	bool "SNIFFER"
#	depends on MT_AP_SUPPORT
#	default n

#config CFG80211_SUPPORT
#	bool "CFG80211"
#	depends on MT_AP_SUPPORT
#	default y

config MT7615E_CON_WPS_SUPPORT
	bool "Concurrent WPS Support"
	depends on MT7615E_MT_AP_SUPPORT
	depends on MT7615E_APCLI_SUPPORT
	depends on MT7615E_WSC_INCLUDED
	depends on MT7615E_WSC_V2_SUPPORT
	default y

#config LLTD_SUPPORT
#	bool "LLTD (Link Layer Topology Discovery Protocol)"
#	depends on MT_AP_SUPPORT

#config COC_SUPPORT
#	bool "CoC Support"
#	depends on MT_AP_SUPPORT
#	default n

#config  RT2860V2_SNMP
#	bool "Net-SNMP Support"
#	depends on MT_AP_SUPPORT

#config MCAST_RATE_SPECIFIC
#	bool "User specific tx rate of mcast pkt"
#	depends on MT_AP_SUPPORT

#config EXT_BUILD_CHANNEL_LIST
#	bool "Extension Channel List"
#	depends on MT_AP_SUPPORT

#config AUTO_CH_SELECT_ENHANCE
#	bool "Auto Channel Selection Enhancement"
#	depends on MT_AP_SUPPORT

config MT7615E_VOW_SUPPORT
	bool "MediaAir(VOW) support"
	depends on MT7615E_MT_AP_SUPPORT
	default y

#config AIRPLAY_SUPPORT
#	bool "AIRPLAY Support"
#	depends on MT_AP_SUPPORT
#	default n

config MT7615E_BAND_STEERING
	bool "Band Steering"
	depends on MT7615E_MT_AP_SUPPORT
	default y

config MT7615E_MUMIMO_SUPPORT
	bool "MU-MIMO Support"
	depends on MT7615E_MT_AP_SUPPORT
	default y

config MT7615E_MU_RA_SUPPORT
  	bool "MU-RGA Support"
  	depends on MT7615E_MUMIMO_SUPPORT
  	default y

config MT7615E_TXOP_ARBITER
	bool "TXOP_ARBITER Support"
	depends on MT7615E_MT_AP_SUPPORT
	default y

config MT7615E_CFG_SUPPORT_DYNAMIC_TXOP
	bool "DYNAMIC_TXOP Support"
	depends on MT7615E_TXOP_ARBITER
	default y

config MT7615E_LED_CONTROL_SUPPORT
	bool "LED Control Support"
	default n

endmenu

endif

if MT7615E_WIFI_RLT_MAC
	config MT7615E_RLT_MAC
	bool
	default y
endif

if MT7615E_WIFI_RTMP_MAC
	config MT7615E_RTMP_MAC
	bool
	default y
endif

config MT7615E_WIFI_MT_MAC
	bool
	default y

if MT7615E_WIFI_MT_MAC
	config MT7615E_MT_MAC
	bool
	default y

	config MT7615E_CHIP_MT7603E
	bool
		default n

	config MT7615E_CHIP_MT7615E
	bool
	default y
endif

if MT7615E_CHIP_MT7615E
	config MT7615E_MT_MAC
		bool
		default y
		select MT7615E_RATE_ADAPTION
		select MT7615E_RATE_ADAPT_AGBS_SUPPORT
		select MT7615E_DOT11_N_SUPPORT
		select MT7615E_DOT11_VHT_AC
		select MT7615E_HDR_TRANS_TX_SUPPORT
		select MT7615E_HDR_TRANS_RX_SUPPORT
endif

config MT7615E_RA_HW_NAT
	bool
	default y

config MT7615E_RA_HW_NAT_WIFI_NEW_ARCH
	bool
	default y

endif

config MT7615E_MULTI_INF_SUPPORT
		bool
		default y if !MT7615E_FIRST_IF_NONE && !MT7615E_SECOND_IF_NONE


config MT7615E_SPECTRUM_SUPPORT
	bool "Wifi Spectrum Support"
	depends on MT7615E_WIFI_DRIVER
	depends on MT7615E_MT_AP_SUPPORT
	default y

config MT7615E_RLM_CAL_CACHE_SUPPORT
	bool "RlmCalibrationCache Support"
	depends on MT7615E_WIFI_DRIVER
	default y

config MT7615E_RED_SUPPORT
        bool "RED(Random Early Drop) support"
	depends on MT7615E_WIFI_DRIVER
	depends on MT7615E_MT_AP_SUPPORT || MT7615E_MT_STA_SUPPORT
        default y

config MT7615E_FQ_SCH_SUPPORT
	bool "Fair Queueing support"
	depends on MT7615E_WIFI_DRIVER
	depends on MT7615E_MT_AP_SUPPORT && MT7615E_VOW_SUPPORT
	depends on MT7615E_CHIP_MT7622
	default y
```
